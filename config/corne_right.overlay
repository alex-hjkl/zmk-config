/ {
    chosen {
        zmk,underglow = &led_strip;
    };
};

&spi3 {
    status = "okay";

    led_strip: ws2812@0 {
        compatible = "worldsemi,ws2812-spi";
        reg = <0>;
        spi-max-frequency = <4000000>;
        chain-length = <1>;
        color-mapping = <1 0 2>; /* GRB */
        spi-one-frame = <0x70>;
        spi-zero-frame = <0x40>;
    };
};
